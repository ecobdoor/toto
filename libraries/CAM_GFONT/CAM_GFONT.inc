/**
 *	Don't modify, this file is generated automatically
 *	This font occupies approximately 1200 bytes
 */
#define DEF_FW 8
#define DEF_FH 13
#define DEF_FN 96
static const uint8_t gFont[96][13] = {
	{ 3,	//ascii 32:0x20 ' '
	  0b00000000,	 //|        |,
	  0b00000000,	 //|        |,
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	  0b00000000,	 //|        |,
	},
	{ 5,	//ascii 33:0x21 '!'
	  0b00000000,	 //|        |,
	  0b00100000,	 //|  @     |,
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	  0b00000000,	 //|        |,
	},
	{ 5,	//ascii 34:0x22 '"'
	  0b00000000,	 //|        |,
	  0b01010000,	 //| @ @    |,
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	  0b00000000,	 //|        |,
	},
	{ 8,	//ascii 35:0x23 '#'
	  0b00000000,	 //|        |,
	  0b00000000,	 //|        |,
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	  0b00000000,	 //|        |,
	},
	{ 8,	//ascii 36:0x24 '$'
	  0b00000000,	 //|        |,
	  0b00010000,	 //|   @    |,
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	  0b00000000,	 //|        |,
	},
	{ 7,	//ascii 37:0x25 '%'
	  0b00000000,	 //|        |,
	  0b11100100,	 //|@@@  @  |,
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	  0b00000000,	 //|        |,
	},
	{ 7,	//ascii 38:0x26 '&'
	  0b00000000,	 //|        |,
	  0b00110000,	 //|  @@    |,
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	  0b00000000,	 //|        |,
	},
	{ 5,	//ascii 39:0x27 '''
	  0b00000000,	 //|        |,
	  0b00100000,	 //|  @     |,
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	  0b00000000,	 //|        |,
	},
	{ 5,	//ascii 40:0x28 '('
	  0b00001000,	 //|    @   |,
	  0b00010000,	 //|   @    |,
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	  0b00000000,	 //|        |,
	},
	{ 5,	//ascii 41:0x29 ')'
	  0b00100000,	 //|  @     |,
	  0b00010000,	 //|   @    |,
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	  0b00000000,	 //|        |,
	},
	{ 6,	//ascii 42:0x2A '*'
	  0b00000000,	 //|        |,
	  0b00000000,	 //|        |,
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	  0b00000000,	 //|        |,
	},
	{ 6,	//ascii 43:0x2B '+'
	  0b00000000,	 //|        |,
	  0b00000000,	 //|        |,
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	  0b00000000,	 //|        |,
	},
	{ 5,	//ascii 44:0x2C ','
	  0b00000000,	 //|        |,
	  0b00000000,	 //|        |,
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	  0b00000000,	 //|        |,
	},
	{ 6,	//ascii 45:0x2D '-'
	  0b00000000,	 //|        |,
	  0b00000000,	 //|        |,
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	  0b00000000,	 //|        |,
	},
	{ 5,	//ascii 46:0x2E '.'
	  0b00000000,	 //|        |,
	  0b00000000,	 //|        |,
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	  0b00000000,	 //|        |,
	},
	{ 6,	//ascii 47:0x2F '/'
	  0b00000100,	 //|     @  |,
	  0b00000100,	 //|     @  |,
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	  0b00000000,	 //|        |,
	},
	{ 7,	//ascii 48:0x30 '0'
	  0b00000000,	 //|        |,
	  0b00111010,	 //|  @@@ @ |,
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	  0b00000000,	 //|        |,
	},
	{ 5,	//ascii 49:0x31 '1'
	  0b00000000,	 //|        |,
	  0b00010000,	 //|   @    |,
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	  0b00000000,	 //|        |,
	},
	{ 5,	//ascii 50:0x32 '2'
	  0b00000000,	 //|        |,
	  0b01110000,	 //| @@@    |,
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	  0b00000000,	 //|        |,
	},
	{ 5,	//ascii 51:0x33 '3'
	  0b00000000,	 //|        |,
	  0b11111000,	 //|@@@@@   |,
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	  0b00000000,	 //|        |,
	},
	{ 6,	//ascii 52:0x34 '4'
	  0b00000000,	 //|        |,
	  0b00001000,	 //|    @   |,
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	  0b00000000,	 //|        |,
	},
	{ 5,	//ascii 53:0x35 '5'
	  0b00000000,	 //|        |,
	  0b11111000,	 //|@@@@@   |,
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	  0b00000000,	 //|        |,
	},
	{ 5,	//ascii 54:0x36 '6'
	  0b00000000,	 //|        |,
	  0b00110000,	 //|  @@    |,
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	  0b00000000,	 //|        |,
	},
	{ 5,	//ascii 55:0x37 '7'
	  0b00000000,	 //|        |,
	  0b11111000,	 //|@@@@@   |,
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	  0b00000000,	 //|        |,
	},
	{ 6,	//ascii 56:0x38 '8'
	  0b00000000,	 //|        |,
	  0b00110000,	 //|  @@    |,
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	  0b00000000,	 //|        |,
	},
	{ 6,	//ascii 57:0x39 '9'
	  0b00000000,	 //|        |,
	  0b00110000,	 //|  @@    |,
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	  0b00000000,	 //|        |,
	},
	{ 5,	//ascii 58:0x3A ':'
	  0b00000000,	 //|        |,
	  0b00000000,	 //|        |,
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	  0b00000000,	 //|        |,
	},
	{ 5,	//ascii 59:0x3B ';'
	  0b00000000,	 //|        |,
	  0b00000000,	 //|        |,
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	  0b00000000,	 //|        |,
	},
	{ 5,	//ascii 60:0x3C '<'
	  0b00000000,	 //|        |,
	  0b00000000,	 //|        |,
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	  0b00000000,	 //|        |,
	},
	{ 5,	//ascii 61:0x3D '='
	  0b00000000,	 //|        |,
	  0b00000000,	 //|        |,
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	  0b00000000,	 //|        |,
	},
	{ 5,	//ascii 62:0x3E '>'
	  0b00000000,	 //|        |,
	  0b00000000,	 //|        |,
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	  0b00000000,	 //|        |,
	},
	{ 6,	//ascii 63:0x3F '?'
	  0b00111000,	 //|  @@@   |,
	  0b01000100,	 //| @   @  |,
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	  0b00000000,	 //|        |,
	},
	{ 7,	//ascii 64:0x40 '@'
	  0b00000000,	 //|        |,
	  0b00111000,	 //|  @@@   |,
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	  0b00000000,	 //|        |,
	},
	{ 7,	//ascii 65:0x41 'A'
	  0b00000000,	 //|        |,
	  0b00010000,	 //|   @    |,
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	  0b00000000,	 //|        |,
	},
	{ 7,	//ascii 66:0x42 'B'
	  0b00000000,	 //|        |,
	  0b01111000,	 //| @@@@   |,
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	  0b00000000,	 //|        |,
	},
	{ 7,	//ascii 67:0x43 'C'
	  0b00000000,	 //|        |,
	  0b00111000,	 //|  @@@   |,
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	  0b00000000,	 //|        |,
	},
	{ 7,	//ascii 68:0x44 'D'
	  0b00000000,	 //|        |,
	  0b01111000,	 //| @@-@   |,
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	  0b00000000,	 //|        |,
	},
	{ 6,	//ascii 69:0x45 'E'
	  0b00000000,	 //|        |,
	  0b01111100,	 //| @@@@@  |,
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	  0b00000000,	 //|        |,
	},
	{ 7,	//ascii 70:0x46 'F'
	  0b00000000,	 //|        |,
	  0b01111110,	 //| @@@@@@ |,
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	  0b00000000,	 //|        |,
	},
	{ 7,	//ascii 71:0x47 'G'
	  0b00000000,	 //|        |,
	  0b00111000,	 //|  @@@   |,
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	  0b00000000,	 //|        |,
	},
	{ 7,	//ascii 72:0x48 'H'
	  0b00000000,	 //|        |,
	  0b11000110,	 //|@@   @@ |,
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	  0b00000000,	 //|        |,
	},
	{ 5,	//ascii 73:0x49 'I'
	  0b00000000,	 //|        |,
	  0b00111000,	 //|  @@@   |,
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	  0b00000000,	 //|        |,
	},
	{ 6,	//ascii 74:0x4A 'J'
	  0b00000000,	 //|        |,
	  0b00011100,	 //|   @@@  |,
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	  0b00000000,	 //|        |,
	},
	{ 6,	//ascii 75:0x4B 'K'
	  0b00000000,	 //|        |,
	  0b10001000,	 //|@   @   |,
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	  0b00000000,	 //|        |,
	},
	{ 6,	//ascii 76:0x4C 'L'
	  0b00000000,	 //|        |,
	  0b10000000,	 //|@       |,
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	  0b00000000,	 //|        |,
	},
	{ 7,	//ascii 77:0x4D 'M'
	  0b00000000,	 //|        |,
	  0b10000010,	 //|@     @ |,
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	  0b00000000,	 //|        |,
	},
	{ 6,	//ascii 78:0x4E 'N'
	  0b00000000,	 //|        |,
	  0b10000100,	 //|@    @  |,
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	  0b00000000,	 //|        |,
	},
	{ 6,	//ascii 79:0x4F 'O'
	  0b00000000,	 //|        |,
	  0b01111000,	 //| @@@@   |,
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	  0b00000000,	 //|        |,
	},
	{ 6,	//ascii 80:0x50 'P'
	  0b00000000,	 //|        |,
	  0b11110000,	 //|@@@@    |,
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	  0b00000000,	 //|        |,
	},
	{ 7,	//ascii 81:0x51 'Q'
	  0b00000000,	 //|        |,
	  0b00111000,	 //|  @@@   |,
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	  0b00000000,	 //|        |,
	},
	{ 7,	//ascii 82:0x52 'R'
	  0b00000000,	 //|        |,
	  0b01111000,	 //| @@@@   |,
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	  0b00000000,	 //|        |,
	},
	{ 7,	//ascii 83:0x53 'S'
	  0b00000000,	 //|        |,
	  0b00111000,	 //|  @@@   |,
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	  0b00000000,	 //|        |,
	},
	{ 7,	//ascii 84:0x54 'T'
	  0b00000000,	 //|        |,
	  0b11111110,	 //|@@@-@@@ |,
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	  0b00000000,	 //|        |,
	},
	{ 7,	//ascii 85:0x55 'U'
	  0b00000000,	 //|        |,
	  0b10000010,	 //|@     @ |,
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	  0b00000000,	 //|        |,
	},
	{ 7,	//ascii 86:0x56 'V'
	  0b00000000,	 //|        |,
	  0b10000010,	 //|@     @ |,
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	  0b00000000,	 //|        |,
	},
	{ 7,	//ascii 87:0x57 'W'
	  0b00000000,	 //|        |,
	  0b10000010,	 //|@     @ |,
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	  0b00000000,	 //|        |,
	},
	{ 7,	//ascii 88:0x58 'X'
	  0b00000000,	 //|        |,
	  0b10000010,	 //|@     @ |,
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	  0b00000000,	 //|        |,
	},
	{ 7,	//ascii 89:0x59 'Y'
	  0b00000000,	 //|        |,
	  0b10000010,	 //|@     @ |,
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	  0b00000000,	 //|        |,
	},
	{ 7,	//ascii 90:0x5A 'Z'
	  0b00000000,	 //|        |,
	  0b11111110,	 //|@@@@@@@ |,
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	  0b00000000,	 //|        |,
	},
	{ 5,	//ascii 91:0x5B '['
	  0b00111000,	 //|  @@@   |,
	  0b00100000,	 //|  @     |,
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	  0b00000000,	 //|        |,
	},
	{ 6,	//ascii 92:0x5C '\'
	  0b01000000,	 //| @      |,
	  0b01000000,	 //| @      |,
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	  0b00000000,	 //|        |,
	},
	{ 5,	//ascii 93:0x5D ']'
	  0b00111000,	 //|  @@@   |,
	  0b00001000,	 //|    @   |,
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	  0b00000000,	 //|        |,
	},
	{ 6,	//ascii 94:0x5E '^'
	  0b00000000,	 //|        |,
	  0b00010000,	 //|   @    |,
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	  0b00000000,	 //|        |,
	},
	{ 7,	//ascii 95:0x5F '_'
	  0b00000000,	 //|        |,
	  0b00000000,	 //|        |,
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	  0b00000000,	 //|        |,
	},
	{ 4,	//ascii 96:0x60 '`'
	  0b00000000,	 //|        |,
	  0b00100000,	 //|  @     |,
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	  0b00000000,	 //|        |,
	},
	{ 6,	//ascii 97:0x61 'a'
	  0b00000000,	 //|        |,
	  0b00000000,	 //|        |,
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	  0b00000000,	 //|        |,
	},
	{ 6,	//ascii 98:0x62 'b'
	  0b00000000,	 //|        |,
	  0b10000000,	 //|@       |,
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	  0b00000000,	 //|        |,
	},
	{ 5,	//ascii 99:0x63 'c'
	  0b00000000,	 //|        |,
	  0b00000000,	 //|        |,
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	  0b00000000,	 //|        |,
	},
	{ 6,	//ascii 100:0x64 'd'
	  0b00000000,	 //|        |,
	  0b00000100,	 //|     @  |,
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	  0b00000000,	 //|        |,
	},
	{ 5,	//ascii 101:0x65 'e'
	  0b00000000,	 //|        |,
	  0b00000000,	 //|        |,
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	  0b00000000,	 //|        |,
	},
	{ 5,	//ascii 102:0x66 'f'
	  0b00000000,	 //|        |,
	  0b01110000,	 //| @@@    |,
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	  0b00000000,	 //|        |,
	},
	{ 6,	//ascii 103:0x67 'g'
	  0b00000000,	 //|        |,
	  0b00000000,	 //|        |,
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	  0b00111000,	 //|  @@@   |,
	},
	{ 5,	//ascii 104:0x68 'h'
	  0b00000000,	 //|        |,
	  0b10000000,	 //|@       |,
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	  0b00000000,	 //|        |,
	},
	{ 4,	//ascii 105:0x69 'i'
	  0b00000000,	 //|        |,
	  0b00000000,	 //|        |,
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	  0b00000000,	 //|        |,
	},
	{ 5,	//ascii 106:0x6A 'j'
	  0b00000000,	 //|        |,
	  0b00000000,	 //|        |,
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	  0b00110000,	 //|  @@    |,
	},
	{ 4,	//ascii 107:0x6B 'k'
	  0b00000000,	 //|        |,
	  0b10000000,	 //|@       |,
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	  0b00000000,	 //|        |,
	},
	{ 4,	//ascii 108:0x6C 'l'
	  0b00000000,	 //|        |,
	  0b01000000,	 //| @      |,
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	  0b00000000,	 //|        |,
	},
	{ 6,	//ascii 109:0x6D 'm'
	  0b00000000,	 //|        |,
	  0b00000000,	 //|        |,
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	  0b00000000,	 //|        |,
	},
	{ 5,	//ascii 110:0x6E 'n'
	  0b00000000,	 //|        |,
	  0b00000000,	 //|        |,
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	  0b00000000,	 //|        |,
	},
	{ 5,	//ascii 111:0x6F 'o'
	  0b00000000,	 //|        |,
	  0b00000000,	 //|        |,
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	  0b00000000,	 //|        |,
	},
	{ 6,	//ascii 112:0x70 'p'
	  0b00000000,	 //|        |,
	  0b00000000,	 //|        |,
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	  0b10000000,	 //|@       |,
	},
	{ 6,	//ascii 113:0x71 'q'
	  0b00000000,	 //|        |,
	  0b00000000,	 //|        |,
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	  0b00000100,	 //|     @  |,
	},
	{ 5,	//ascii 114:0x72 'r'
	  0b00000000,	 //|        |,
	  0b00000000,	 //|        |,
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	  0b00000000,	 //|        |,
	},
	{ 5,	//ascii 115:0x73 's'
	  0b00000000,	 //|        |,
	  0b00000000,	 //|        |,
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	  0b00000000,	 //|        |,
	},
	{ 5,	//ascii 116:0x74 't'
	  0b00000000,	 //|        |,
	  0b01000000,	 //| @      |,
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	  0b00000000,	 //|        |,
	},
	{ 5,	//ascii 117:0x75 'u'
	  0b00000000,	 //|        |,
	  0b00000000,	 //|        |,
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	  0b00000000,	 //|        |,
	},
	{ 5,	//ascii 118:0x76 'v'
	  0b00000000,	 //|        |,
	  0b00000000,	 //|        |,
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	  0b00000000,	 //|        |,
	},
	{ 7,	//ascii 119:0x77 'w'
	  0b00000000,	 //|        |,
	  0b00000000,	 //|        |,
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	  0b00000000,	 //|        |,
	},
	{ 5,	//ascii 120:0x78 'x'
	  0b00000000,	 //|        |,
	  0b00000000,	 //|        |,
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	  0b00000000,	 //|        |,
	},
	{ 6,	//ascii 121:0x79 'y'
	  0b00000000,	 //|        |,
	  0b00000000,	 //|        |,
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	  0b11000000,	 //|@@      |,
	},
	{ 5,	//ascii 122:0x7A 'z'
	  0b00000000,	 //|        |,
	  0b00000000,	 //|        |,
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	  0b00000000,	 //|        |,
	},
	{ 5,	//ascii 123:0x7B '{'
	  0b00001000,	 //|    @   |,
	  0b00010000,	 //|   @    |,
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	  0b00000000,	 //|        |,
	},
	{ 5,	//ascii 124:0x7C '|'
	  0b00100000,	 //|  @     |,
	  0b00100000,	 //|  -     |,
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	  0b00100000,	 //|  @     |,
	},
	{ 5,	//ascii 125:0x7D '}'
	  0b00100000,	 //|  @     |,
	  0b00010000,	 //|   @    |,
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	  0b00000000,	 //|        |,
	},
	{ 5,	//ascii 126:0x7E '~'
	  0b00000000,	 //|        |,
	  0b00000000,	 //|        |,
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	  0b00000000,	 //|        |,
	},
	{ 8,	//ascii 127:0x7F ''
	  0b11111111,	 //|@@@@-@@@|,
	  0b11111111,	 //|@@@@-@@@|,
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	  0b11111111,	 //|@@@@@@@@|,
	},
};
///////////////////////////////////////////////////////////////////////
